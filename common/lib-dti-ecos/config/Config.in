## common/lib-dti-ecos/config/Config.in
```kconfig
config COMMON_DTI_DEBUG_PRINTS
	bool
	prompt "Enable verbose debug output"
	default y

config COMMON_DTI_ERROR_PRINTS
	bool
	prompt "Enable error output"
	default y
```

## common/ltq-acli/config/Config.in
```kconfig
config LANTIQ_ACLI_PIPE_NAME
        depends on PACKAGE_ltq-acli
        string "Default name of pipe"
        default ""
        help
                Default name of pipe

menu "Advanced configuration (for developers)"
        depends on PACKAGE_ltq-acli

config LANTIQ_ACLI_USER_FLAGS
        depends on PACKAGE_ltq-acli
        string "Additional CFLAGS"
        default ""
        help
                Additional CFLAGS for compilation (for developers)

config LANTIQ_ACLI_USER_OPTIONS
        depends on PACKAGE_ltq-acli
        string "Additional configure options"
        default ""
        help
                Additional configure options (for developers)

endmenu
```

## dsl_cpe/dsl-gfast-api-vrx618/config/Config.in
```kconfig
config DSL_GFAST_MAX_DEVICE_VRX618
	string
	prompt "Number of devices"
	default 1
	help
	This option specifies the number of Vinax3 devices to support.
	
config DSL_GFAST_LINES_PER_DEVICE_VRX618
	string
	prompt "Lines per Device"
	default 1
	help
	This option specifies the number of lines per device to support.

config DSL_GFAST_CHANNELS_PER_LINE_VRX618
	string
	prompt "Channels per Lines"
	default 1
	help
	This option specifies the number of bearer channels per line to support.

config DSL_GFAST_MAX_PROFILE_VRX618
	string
	prompt "Max Number of Profiles"
	default 8
	help
	This option specifies the number of configuration profiles. Normally it should match the total number of lines: <num of devices> * <lines per device>.

config DSL_GFAST_DEBUG_FEATURES
   bool
   prompt "Additional Debug Features"
   default n
   help
   This switch enables additional debug features like PM TIF and DB test

config DSL_GFAST_LIBRARY_ONLY
   bool
   prompt "DSL-Library only"
   default n
   help
   This switch enables a build of the DSL-API as a library only. DSL-Daemon and dsl_pipe tool are skipped.
```

## dsl_cpe/dsl-gfast-drv-pmi/config/Config.in
```kconfig
config DSL_GFAST_DRV_PMI_ALL_STATIC
	bool
	prompt "Enable all-static build"
	default n
	help
	If static-all is enabled the control_ive driver test application will be build 
	in a raw static form. All libraries (also the OS libs) are linked statically.

config DSL_GFAST_DRV_PMI_DEBUG
	bool
	prompt "Add -O1 -g3 to CFLAGS"
	default n

config DSL_GFAST_DRV_PMI_DEBUG_PRINTS
	bool
	prompt "Enable verbose debug output"
	default y

config DSL_GFAST_DRV_PMI_ERROR_PRINTS
	bool
	prompt "Enable error output"
	default y

config DSL_GFAST_DRV_PMI_STATISTICS
	bool
	prompt "Enable driver statistics support"
	default y

config DSL_GFAST_DRV_PMI_ERR_STRINGS
	bool
	prompt "Enable error and return code description"
	default y

config DSL_GFAST_DRV_PMI_PLATFORM_DRV
	bool
	prompt "Enable LINUX Platform Driver/Device"
	default y

config DSL_GFAST_DRV_PMI_DRV_BUILTIN_TESTS
	bool
	prompt "Enable driver builtin tests"
	default n

config DSL_GFAST_DRV_PMI_LAUTERBACH
	bool
	prompt "Enable Lauterbach settings"
	default n

choice
	prompt "Device Access Mode"
	default DSL_GFAST_DRV_PMI_MODE_EXT_FCT
	help
		Select the Device Access Mode (default for device, simulation, emulation).

	config DSL_GFAST_DRV_PMI_MODE_none
		bool "VRX618 Device - default device access"

	config DSL_GFAST_DRV_PMI_MODE_EXT_FCT
		bool "VRX618 Device - device access via function (testing, debugging)"

	config DSL_GFAST_DRV_PMI_MODE_SIMULATION
		bool "SW Simulation - Simulator Module required"

	config DSL_GFAST_DRV_PMI_MODE_EMULATION
		bool "Emulation"

endchoice 
```

## dsl_cpe/dsl-vr11-firmware-xdsl/Config.in
```kconfig
menu "Configuration"
	depends on PACKAGE_dsl-vr11-firmware-xdsl

	config dsl-vr11-firmware-xdsl_FW_IN_ROOTFS
		bool "Include DSL Firmware in rootfs (instead of separate flash partition)"
		default y

endmenu
```

## dsl_cpe/dti-pmi/config/Config.in
```kconfig
config DSL_CO_PMI_DTI_ALL_STATIC
	bool
	prompt "Enable all-static build"
	default n
	help
	If all-static is enabled the PMI daemon and the PMI pipe client application
	will be build in a raw static form. All libraries (also the OS libs) are
	linked statically.

config DSL_CO_PMI_DTI_DEBUG_PRINTS
	bool
	prompt "Enable verbose debug output"
	default y

config DSL_CO_PMI_DTI_ERROR_PRINTS
	bool
	prompt "Enable error output"
	default y

config DSL_CO_PMI_DTI_STANDALONE_AGENT
	bool
	prompt "Install the DTI PMI Standalone agent"
	default y
```

## ltq-voice-kpi2udp/config/Config.in
```kconfig
menu "advanced configuration (for developers)"
        depends on PACKAGE_ltq-voice-kpi2udp

config LTQ_VOICE_KPI2UDP_USER_FLAGS
        depends on PACKAGE_ltq-voice-kpi2udp
        string "Additional CFLAGS"
        default ""
        help
                Additional CFLAGS for compilation (for developers)

config LTQ_VOICE_KPI2UDP_USER_OPTIONS
        depends on PACKAGE_ltq-voice-kpi2udp
        string "Additional autogen configure options"
        default ""
        help
                Additional autogen configure options (for developers)
endmenu
```

## ltq-voice-tapi-lib-nlt/config/Config.in
```kconfig
menu "advanced configuration (for developers)"
        depends on PACKAGE_ltq-voice-lib-nlt

config LTQ_VOICE_LIB_NLT_USER_FLAGS
        depends on PACKAGE_ltq-voice-lib-nlt
        string "Additional CFLAGS"
        default ""
        help
                Additional CFLAGS for compilation (for developers)

config LTQ_VOICE_LIB_NLT_USER_OPTIONS
        depends on PACKAGE_ltq-voice-lib-nlt
        string "Additional autogen configure options"
        default ""
        help
                Additional autogen configure options (for developers)

config  LTQ_VOICE_LIB_NLT_IFXOS_SUPPORT
	bool "enable IFXOS library support"
	depends on PACKAGE_ltq-voice-lib-nlt
	default n
	help
		Option to enable IFXOS library usage

endmenu

config  LTQ_VOICE_LIB_NLT_VMMC
	bool "enable support for SLIC1xx devices"
	depends on PACKAGE_ltq-voice-lib-nlt
		default y if PACKAGE_ltq-voice-vmmc
	default y if PACKAGE_ltq-voice-vmmc || PACKAGE_ltq-voice-vmmc-xrx500
	default n
	help
		Option to enable Line Testing support for SLIC1xx family devices

config  LTQ_VOICE_LIB_NLT_S220
	bool "enable support for SLIC2xx devices"
	depends on PACKAGE_ltq-voice-lib-nlt
		default y if PACKAGE_ltq-voice-s220
	default y if PACKAGE_ltq-voice-s220 || PACKAGE_ltq-voice-vmmc-xrx500
	default n
	help
		Option to enable Line Testing support for SLIC2xx family devices

config  LTQ_VOICE_LIB_NLT_DXT
	bool "enable support for DUSLIC-xT device"
	depends on PACKAGE_ltq-voice-lib-nlt
	depends on PACKAGE_ltq-voice-duslic_xt
	default y if PACKAGE_ltq-voice-duslic_xt
	default n
	help
		Option to enable Line Testing support for DUSLIC-xT device

config  LTQ_VOICE_LIB_NLT_DXS
	bool "enable support for DUSLIC XS device"
	depends on PACKAGE_ltq-voice-lib-nlt
	default y if PACKAGE_ltq-voice-duslic_xs
	default n
	help
		Option to enable Line Testing support for DUSLIC XS device
		
```
